## BTP-1/Codes/board file/rpi_pico_rp2040_w/Kconfig
```kconfig
# Copyright (c) 2021 Yonatan Schachter
# SPDX-License-Identifier: Apache-2.0

config BOARD_RPI_PICO
	bool "Raspberry Pi Pico"
	select RP2_FLASH_W25Q080
```
