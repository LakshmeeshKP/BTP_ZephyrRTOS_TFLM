## CMakeLists.txt
```
cmake_minimum_required(VERSION 3.20.0)

find_package(Zephyr REQUIRED HINTS $ENV{ZEPHYR_BASE})
project(final2imp)


file(GLOB app_sources src/*)
target_sources(app PRIVATE ${app_sources})
```

## prj.conf
```kconfig
CONFIG_CPP=y
CONFIG_STD_CPP17=y
CONFIG_TENSORFLOW_LITE_MICRO=y
CONFIG_REQUIRES_FULL_LIBC=y 

#cmsis preprocessing
CONFIG_REQUIRES_FLOAT_PRINTF=y
CONFIG_CMSIS_DSP=y
CONFIG_CMSIS_DSP_TRANSFORM=y
CONFIG_CMSIS_DSP_STATISTICS=y
CONFIG_CMSIS_DSP_BASICMATH=y
CONFIG_CMSIS_DSP_COMPLEXMATH=y
CONFIG_CMSIS_DSP_MATRIX=y

#mic
CONFIG_ADC=y

CONFIG_USB_DEVICE_INITIALIZE_AT_BOOT=y
CONFIG_TEST_RANDOM_GENERATOR=y
CONFIG_MAIN_STACK_SIZE=2048
```

## mic_pico_w.overlay
```dts
/ {
	zephyr,user {
		io-channels = <&adc 0>;
	};
};

&adc {
	#address-cells = <1>;
	#size-cells = <0>;
    
	status="okay";

	channel@0 {
		reg = <0>;
		zephyr,gain = "ADC_GAIN_1";
		zephyr,reference = "ADC_REF_INTERNAL";
		zephyr,acquisition-time = <ADC_ACQ_TIME_DEFAULT>;
		zephyr,resolution = <12>;
	};
};
```

## src/main.c
```c
#include <zephyr/kernel.h>
#include <zephyr/sys/clock.h>
#include <stdio.h>
#include "arm_math.h"
#include "constants.h"
#include "tflm_functions.h"
#include "mic_functions.h"

arm_status status;
arm_mfcc_instance_f32 mfcc_inst;

uint16_t samples[16000];
float32_t mfcc_input[256]; 
float32_t mfcc_output[256];

void mfcc_init(void);
void get_spectrogram_stream(uint16_t input[16000]);

int main(void){
    k_sleep(K_MSEC(5000));
    init_mic();
    mfcc_init();
    tflm_init();
    while(1){
        printf("recording in 3..\n");
        k_sleep(K_MSEC(1000));
        printf("recording in 2..\n");
        k_sleep(K_MSEC(1000));
        printf("recording in 1..\n");
        k_sleep(K_MSEC(1000));

        //get 1 sec audio samples at 8khz and interpolate to 16khz
        sample_audio_int(samples, 8000, 1);
        k_sleep(K_MSEC(1000));

        uint32_t start_cycles = k_cycle_get_32(); //to measure features computation time
        get_spectrogram_stream(samples); 
	    uint32_t delay_time = k_cyc_to_us_floor32((uint64_t)(k_cycle_get_32() - start_cycles));
	    printk("spectrogram time: %d us\n", delay_time);
        
        printk("start inference\n");
        k_sleep(K_MSEC(1000));

        start_cycles = k_cycle_get_32(); //to measure inference time
        perform_inference_stream();
	    delay_time = k_cyc_to_us_floor32((uint64_t)(k_cycle_get_32() - start_cycles));
	    printk("inference time: %d us\n", delay_time);

        k_sleep(K_MSEC(5000));
    }

    return 0;
}

void mfcc_init(void){
    status = arm_mfcc_init_f32(&mfcc_inst, mfcc_init_fftLen, nbMelFilters, nbDctOutputs, dctCoefs, filterPos, filterLengths, filterCoefs, windowCoefs);
    if (status != ARM_MATH_SUCCESS) {
        printf("init failed!\n");
        while(1){}; 
    }
    printf("mfcc init success\n");
}

void get_spectrogram_stream(uint16_t input[16000]){
    for (int i = 0; i < 125; i++) {
        int base = i * 128;
        for (int j = 0; j < 256; j++) {
            int idx1=base+j;
            mfcc_input[j] = (idx1 < 16000) ? (float)(input[idx1]/32768.0f - 1.0f) : 0.01f; //convert to from uint16 to float
        }
        arm_mfcc_f32(&mfcc_inst, mfcc_input, mfcc_output, temp); 
        for (int k = 0; k < 13; k++) {
            mfcc_output[k] = mfcc_output[k]/1.33f;
        }  
        insert_input(mfcc_output, nbDctOutputs); //quantise input and insert into tflm input buffer
    }
}
```

## src/constants.h
```c
#ifndef CONSTANTS_H
#define CONSTANTS_H

#include "arm_math.h"

extern uint32_t mfcc_init_fftLen;
extern uint32_t nbMelFilters; 
extern uint32_t nbDctOutputs; 

extern const uint32_t filterPos[20];
extern const uint32_t filterLengths[20];
extern const float32_t dctCoefs[260];
extern const float32_t filterCoefs[236];
extern const float32_t windowCoefs[256];

extern float32_t temp[258]; 

extern float audio_samples[16000]; 


#endif
```

## src/mic_functions.c
```c
/*
 * Copyright (c) 2020 Libre Solar Technologies GmbH
 *
 * SPDX-License-Identifier: Apache-2.0
 */

#include <inttypes.h>
#include <stddef.h>
#include <stdint.h>

#include <zephyr/device.h>
#include <zephyr/devicetree.h>
#include <zephyr/drivers/adc.h>
#include <zephyr/kernel.h>
#include <zephyr/sys/printk.h>
#include <zephyr/sys/util.h>
#include "mic_functions.h"

#include <zephyr/drivers/timer/system_timer.h>
#include <zephyr/sys/clock.h>
#include <zephyr/sys/time_units.h>

//refered from zephyr adc_dt example
//safety check to see if zephyr_user is defined and io_channels is mentioned
#if !DT_NODE_EXISTS(DT_PATH(zephyr_user)) || \
	!DT_NODE_HAS_PROP(DT_PATH(zephyr_user), io_channels)
#error "No suitable devicetree overlay specified"
#endif

#define DT_SPEC_AND_COMMA(node_id, prop, idx) \
	ADC_DT_SPEC_GET_BY_IDX(node_id, idx),

/* Data of ADC io-channels specified in devicetree. */
static const struct adc_dt_spec adc_channels[] = {
	DT_FOREACH_PROP_ELEM(DT_PATH(zephyr_user), io_channels,
			     DT_SPEC_AND_COMMA)
};

uint16_t init_mic(void);
uint16_t read_mic(void);
void sample_audio_int(uint16_t *out, int samp_rate, int seconds);

uint32_t delay_time=0;
int err;
uint16_t buf;
struct adc_sequence sequence = {
	.buffer = &buf,
	.buffer_size = sizeof(buf), //size in bytes
};


// setup ADC for mic
uint16_t init_mic(void){
	if (!adc_is_ready_dt(&adc_channels[0])) {
		printk("ADC controller device %s not ready\n", adc_channels[0].dev->name);
		return 0;
	}
	err = adc_channel_setup_dt(&adc_channels[0]);
	if (err < 0) {
		printk("Could not setup channel #%d (%d)\n", 0, err);
		return 0;
	}
	printk("mic init success\n");
	(void)adc_sequence_init_dt(&adc_channels[0], &sequence);
	return 0;
}

// read ADC value corresponding to mic input
uint16_t read_mic(void){
	err = adc_read_dt(&adc_channels[0], &sequence);
	if (err < 0) {
		printk("Could not read (%d)\n", err);
	}
	return buf;
}

//for sampling of audio at 8khz and interpolating to 16khz
void sample_audio_int(uint16_t *out, int samp_rate, int seconds){
	int32_t samp_delay = 1000000/samp_rate;  //us delay between samples (125us delay)
	uint16_t iters=samp_rate*seconds * 2; //16000 samps
	uint32_t period_cyc = k_us_to_cyc_floor32(125);
	uint32_t next_deadline = k_cycle_get_32();
	uint32_t start_cycles = k_cycle_get_32();
	printk("start sampling\n");
	for (uint16_t i=0; i<iters; i=i+2){
		next_deadline += period_cyc;
		out[i] = read_mic();
		while(k_cycle_get_32() < next_deadline){
		}
	}

	//interpolation to match 16khz
	for (uint16_t i=1; i<iters; i=i+2){
		if (i==iters-1) out[i] = out[i-1];
		else out[i] = (uint16_t)((out[i-1]+out[i+1]) >> 1);
	}

	printk("end sampling\n");
}
```

## src/mic_functions.h
```c
#ifndef MIC_FUNCTIONS_H
#define MIC_FUNCTIONS_H

#include <stdint.h>

#ifdef __cplusplus
extern "C" {
#endif

uint16_t init_mic(void);
uint16_t read_mic(void);
void sample_audio_int(uint16_t *out, int samp_rate, int seconds);

#ifdef __cplusplus
}
#endif

#endif 
```

## src/tflm_functions.cpp
```c
#include <stdio.h>
#include <stdlib.h>
#include <stdint.h>
#include <tensorflow/lite/micro/micro_mutable_op_resolver.h>
#include <tensorflow/lite/micro/micro_log.h>
#include <tensorflow/lite/micro/micro_interpreter.h>
#include <tensorflow/lite/micro/system_setup.h>
#include <tensorflow/lite/schema/schema_generated.h>
#include <zephyr/random/random.h>
#include <zephyr/sys/time_units.h>
#include <zephyr/kernel.h>
#include "tflm_functions.h"
#include "model_data_small.hpp"
#include "arm_math.h"


namespace {
	const tflite::Model *model = nullptr;
	tflite::MicroInterpreter *interpreter = nullptr;
	TfLiteTensor *input = nullptr;
	TfLiteTensor *output = nullptr;
	static constexpr int kTensorArenaSize = 9104; //in bytes 
	alignas(16) uint8_t tensor_arena[kTensorArenaSize];
	tflite::MicroMutableOpResolver <7> resolver;
} 

float in_scale, out_scale;
float in_scale_q15;
int32_t in_zp, out_zp;
int8_t *input_buf;
static int idx_stream=0;

void tflm_init(void){
	model = tflite::GetModel(model_data_small);
	if (model->version() != TFLITE_SCHEMA_VERSION) {
		MicroPrintf("Model provided is schema version %d not equal "
					"to supported version %d.",
					model->version(), TFLITE_SCHEMA_VERSION);
		return;
	}

	resolver.AddExpandDims();
	resolver.AddConv2D();
	resolver.AddMaxPool2D();
	resolver.AddReshape();
	resolver.AddMean();
	resolver.AddSoftmax();
	resolver.AddFullyConnected();
	
	static tflite::MicroInterpreter static_interpreter(model, resolver, tensor_arena, kTensorArenaSize);
	interpreter = &static_interpreter;
	
	if (interpreter->AllocateTensors() != kTfLiteOk) {
		MicroPrintf("AllocateTensors() failed");
		return;
	}   
	
	input = interpreter->input(0);
	output = interpreter->output(0);
	
	MicroPrintf("Arena used bytes: %d\n", interpreter->arena_used_bytes()); //to optimise arena size
	MicroPrintf("input tensor bytes: %d\n", input->bytes); //debug info
	
	in_scale = input->params.scale, out_scale = output->params.scale;
	in_zp = input->params.zero_point, out_zp = output->params.zero_point;
	
	input_buf = tflite::GetTensorData<int8_t>(input);
	
	MicroPrintf("tflm init success\n");
}

// quantise and insert one frame of MFCC output into tflm input buffer
void insert_input(float frame[256], int DCToutputs){
	for (int j=0; j<DCToutputs; j++){
		int8_t val = (int8_t)(round(frame[j] / in_scale) + in_zp);
		if (val > 127) val = 127;
		if (val < -128) val = -128;
		input_buf[idx_stream++]= val;
	}
}

// perform inference and print best confidence
void perform_inference_stream(void){
	MicroPrintf("invoke status: %d", interpreter->Invoke());
	idx_stream=0; //reset idx for next inference

	float y[8];
	int prediction = -1;
	MicroPrintf("0:'down' 1:'go' 2:'left' 3:'no' 4:'right' 5:'stop' 6:'up' 7:'yes'\n");
	MicroPrintf("predictions:\n");
	for (int i = 0; i<8; i++) {
		y[i] =(tflite::GetTensorData<int8_t>(output)[i] - out_zp) * out_scale;
		MicroPrintf("output %d: %f\n", i, y[i]);
		if (y[i]>0.6f) prediction = i; //cutoff set at 0.6, can be adjusted
	}
	
	switch(prediction){
	case 0:
	MicroPrintf("Detected keyword: down\n");
	break;
	case 1:
	MicroPrintf("Detected keyword: go\n");
	break;		
	case 2:
	MicroPrintf("Detected keyword: left\n");
	break;
	case 3:		
	MicroPrintf("Detected keyword: no\n");
	break;
	case 4:
	MicroPrintf("Detected keyword: right\n");	
	break;
	case 5:
	MicroPrintf("Detected keyword: stop\n");
	break;
	case 6:
	MicroPrintf("Detected keyword: up\n");	
	break;
	case 7:
	MicroPrintf("Detected keyword: yes\n");
	break;
	default:
	MicroPrintf("None\n");
	break;
	}
	return;
}
```

## src/tflm_functions.h
```c
#ifndef TFLM_FUNCTIONS_H
#define TFLM_FUNCTIONS_H

#include <stdint.h>
#include "arm_math.h"

#ifdef __cplusplus
extern "C" {
#endif

void tflm_init(void);
void insert_input(float frame[256], int DCToutputs);
void perform_inference_stream(void);

#ifdef __cplusplus
}
#endif

#endif
```
